// SPDX-License-Identifier: Apache-2.0 OR MIT
// A QEMU-virt-like devicetree: PL011 UART, a coherent PCIe host and a UART
// with an unknown compatible. Rebuild with
// `dtc -I dts -O dtb -o pl011-coherent.dtb pl011-coherent.dts`.
/dts-v1/;

/ {
	#address-cells = <2>;
	#size-cells = <2>;
	compatible = "linux,dummy-virt";

	pl011@9000000 {
		compatible = "arm,pl011", "arm,primecell";
		reg = <0 0x09000000 0 0x1000>;
	};

	serial@9100000 {
		compatible = "vendor,unknown-uart";
		reg = <0 0x09100000 0 0x1000>;
	};

	pcie@10000000 {
		compatible = "pci-host-ecam-generic";
		reg = <0x40 0x10000000 0 0x10000000>;
		dma-coherent;
	};
};
